## src/Kconfig
```kconfig
config GUI_INIT_PRIORITY
    int "GUI Initialization Priority"
    default 91
    range 0 99

config GUI_LOG_LEVEL
    int "GUI Log Level"
    default 3
    range 0 4
    help
      0: OFF, 1: ERROR, 2: WARNING, 3: INFO, 4: DEBUG

config APP_MGR_INIT_PRIORITY
    int "Application Manager Initialization Priority"
    default 92
    range 0 99

config APP_MGR_LOG_LEVEL
    int "Application Manager Log Level"
    default 3
    range 0 4
    help
      0: OFF, 1: ERROR, 2: WARNING, 3: INFO, 4: DEBUG

config APP_THREAD_LOG_LEVEL
    int "Application Thread Log Level"
    default 3
    range 0 4
    help
      0: OFF, 1: ERROR, 2: WARNING, 3: INFO, 4: DEBUG

config APP_THREAD_STACK_SIZE
    int "Application Thread Stack Size"
    default 8192
    help
      LVGL rendering, the apps and JPEG decoding run on this thread.
      Check the real usage in the SysInfo app before shrinking it.

config APP_THREAD_SHOW_FPS
    bool "Show FPS"
    default n

config APP_THREAD_ANIM_DURATION_MS
    int "Application Thread Animation Duration (ms)"
    default 300
    range 0 5000

config APP_THREAD_MAX_SLEEP_MS
    int "Application Thread Maximum Sleep Time (ms)"
    default 50
    range 1 1000

config FILE_INIT_PRIORITY
    int "File System Initialization Priority"
    default 90
    range 0 99

config INPUT_THREAD_STACK_SIZE
    int "Input Thread Stack Size"
    default 8192
    help
      Reads the IMU every 10 ms. Check the real usage in the SysInfo app before shrinking it.

config INPUT_ROLL_INVERT
    bool "Invert left/right tilt"
    help
      Flip the sign of roll for everything that reads it (highlight, Level, Photos).
      Enable if tilting moves the highlight the wrong way on screen, e.g. after
      changing the display mirroring (mdac in app.overlay) or the IMU mounting.

config INPUT_PITCH_INVERT
    bool "Invert forward/backward tilt"
    help
      Flip the sign of pitch for everything that reads it (Level bubble, back gesture
      is not affected since it uses both directions).

config INPUT_LOG_LEVEL
    int "Input Log Level"
    default 3
    range 0 4
    help
      0: OFF, 1: ERROR, 2: WARNING, 3: INFO, 4: DEBUG

rsource "apps/Kconfig.apps"
```

## src/apps/Kconfig.apps
```kconfig
menuconfig APP_MENU
    bool "Enable App Menu"
    default n
    help
      Enable the application menu module.

config APP_BG_LOG_LEVEL
    int "BG APP Log Level"
    default 3
    range 0 4
    help
      0: OFF, 1: ERROR, 2: WARNING, 3: INFO, 4: DEBUG

config APP_FG_LOG_LEVEL
    int "FG APP Log Level"
    default 3
    range 0 4
    help
      0: OFF, 1: ERROR, 2: WARNING, 3: INFO, 4: DEBUG

config APP_FG_PRIORITY_DEFAULT
    int "Default App Foreground Priority"
    default 5
    help
      Default priority for foreground applications.
```
